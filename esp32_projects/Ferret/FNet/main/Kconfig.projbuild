## esp32_projects/Ferret/FNet/main/Kconfig.projbuild
```kconfig
# put here your custom config value
menu "Network Configuration"

config ESP_WIFI_SSID
    string "WiFi SSID"
    default "ssid"
    help
	SSID (network name) for the example to connect to.

config ESP_WIFI_PASSWORD
    string "WiFi Password"
    default "password"
    help
	WiFi password (WPA or WPA2) for the example to use.

config TARGET_IPV4_ADDR
    string "IPV4 Address"
    default "192.168.0.165"
    help
  The example will connect to this IPV4 address.

config TARGET_PORT
    int "Port"
    range 0 65535
    default 3333
    help
  The remote port to which the client example will connect to.

endmenu
```
